## atheros/atheros-wireless/Config.in
```kconfig
# MadWifi configuration

config ATHEROS_VERSION
	string "Atheros Driver Version"
	default '1.3.1.54'
	depends on PACKAGE_kmod-atheros-wireless
	help
	  Use the testing version of MadWiFi, which is newer, but also less tested
	  May contain unexpected bugs :)

config ATHEROS_REMOVE_5G_SUPPORT
	bool "Delete support for 5Ghz"
	depends on PACKAGE_kmod-atheros-wireless
	help

choice
	prompt "Rate control algorithm selection"
	depends on PACKAGE_kmod-atheros-wireless
	default ATHEROS_RCA
	help
	  This option controls how MadWifi chooses its bitrate.

config ATHEROS_RCA
	bool "Use Atheros Ratecontrol 11N"
	help
	  Proprietary ATheros RCA module control

endchoice
```

## broadcom/broadcom-endpointdrv/Config.in
```kconfig
# Broadcom endpointdrv configuration

config ENDPTDRV_VERSION
    string "Broadcom endpoint driver Version"
    default '4.03.20'
    depends on PACKAGE_kmod-broadcom-endpointdrv
    help
	  Choose which release of the broadcom driver to compile into the firmware

config ENDPTDRV_WIDEBAND
    bool "Enable wideband mode"
    default n
    help
	  Enable wideband mode (only for testing) 
```

## broadcom/broadcom-mgcp/Config.in
```kconfig
# Broadcom vodsl configuration

config VODSL_VERSION
    string "Broadcom vodsl (mgcp) client version"
    default 'legacy'
    depends on PACKAGE_kmod-broadcom-endpointdrv
    help
          Choose the version of vodsl to compile into the firmware
```

## broadcom/broadcom-wireless_softs/Config.in
```kconfig
config RADIUS_NAS_PORT_ID
       string "NAS PORT ID"
       default "99.Neufbox.33"

config RADIUS_WISPR_LOCATION_ID_NETWORK_PREFIX
       string "WISPr location id network (prefix)"
       default "SFRWiFiMobile/Neufbox"

config RADIUS_WISPR_LOCATION_NAME_PREFIX
       string "WISPr location name (prefix)"
       default "SFR,Neufbox"
```

## efixo/efixo-libnbd/Config.in
```kconfig
config efixo-nbctl
	bool "Efixo nbctl"
	depends on PACKAGE_efixo-libnbd
	help
	  "CLI nbd control"

config efixo-serialization
	bool"Efixo serialization"
	depends on PACKAGE_efixo-libnbd
	help
	  "CLI neubfox serialization tool"

config efixo-switch-robo
	bool "Efixo switch-robo"
	depends on PACKAGE_efixo-libnbd
	help
	  "CLI switch robo control"

menuconfig efixo-nbd-plugins
	bool "nbd plugins"
	depends on PACKAGE_efixo-nbd

config efixo-nbd-plugin-event
	bool "event plugin" if efixo-nbd-plugins
	default y

config efixo-nbd-plugin-status
	bool "status plugin" if efixo-nbd-plugins
	default y

config efixo-nbd-plugin-nvram
	bool "nvram plugin" if efixo-nbd-plugins
	default y

config CONFIG_VERSION
	string "System config version" if efixo-nbd-plugin-nvram

config SSID_PREFIX
	string "SSID prefix"
	default "SFR"

config HOTSPOT_AUTOCONF_FILE
	string "Hotspot default autconf file"
	default "hotspot.xml"

config SAMBA_SERVICE_NAME
	string "Samba Service Name"
	default "NeufBox"

config UPNPAV_SERVICE_NAME
	string "UpnpAV Service Name"
	default "NeufBox upnp-Av"
	
config VSSTEST_CLI_STRING
	string "VSS ring test CLI string"
	default "Neufbox Test"

config efixo-nbd-plugin-leds
	bool "leds plugin" if efixo-nbd-plugins
	default y

config efixo-nbd-plugin-nbctl
	bool "nbctl plugin" if efixo-nbd-plugins
	default y

config efixo-nbd-plugin-autoconf
	bool "autoconf plugin" if efixo-nbd-plugins

config efixo-nbd-plugin-spy
	bool "spy plugin" if efixo-nbd-plugins

config efixo-nbd-plugin-firewall
	bool "firewall plugin" if efixo-nbd-plugins

config efixo-nbd-plugin-nat
	bool "nat plugin" if efixo-nbd-plugins

config efixo-nbd-plugin-uroute
	bool "uroute plugin" if efixo-nbd-plugins

config efixo-nbd-plugin-uping
	bool "ping plugin" if efixo-nbd-plugins

config efixo-nbd-plugin-utraceroute
	bool "traceroute plugin" if efixo-nbd-plugins

config efixo-nbd-plugin-lan
	bool "lan plugin" if efixo-nbd-plugins

config efixo-nbd-plugin-wlan
	bool "wlan plugin" if efixo-nbd-plugins

config efixo-nbd-plugin-hotspot
	bool "hotspot plugin" if efixo-nbd-plugins

config efixo-nbd-plugin-voip
	bool "voip plugin" if efixo-nbd-plugins

config efixo-nbd-plugin-stb
	bool "stb plugin" if efixo-nbd-plugins

config efixo-nbd-plugin-igmp
	bool "igmp plugin" if efixo-nbd-plugins

config efixo-nbd-plugin-backup3g
	bool "backup3g plugin" if efixo-nbd-plugins
	depends on @neufbox_net_infra_gprs

config efixo-nbd-plugin-dsl
	bool "dsl plugin" if efixo-nbd-plugins
	depends on @neufbox_net_infra_adsl

config efixo-nbd-plugin-plc
	bool "plc plugin" if efixo-nbd-plugins
	depends on PACKAGE_efixo-nbd

config efixo-nbd-plugin-sfp
	bool "sfp plugin" if efixo-nbd-plugins
	depends on @neufbox_net_infra_ftth && @TARGET_octeon

config efixo-nbd-plugin-eco
	bool "eco plugin" if efixo-nbd-plugins
	depends on @PACKAGE_efixo-nbd

config efixo-nbd-plugin-vSStest
	bool "vSStest plugin" if efixo-nbd-plugins
	depends on (@TARGET_brcm63xx || @TARGET_octeon)

config efixo-nbd-plugin-disk
	bool "disk plugin" if efixo-nbd-plugins

config efixo-nbd-plugin-ddnsctl
	bool "ddnsctl plugin" if efixo-nbd-plugins

config efixo-nbd-plugin-sambactl
	bool "sambactl plugin" if efixo-nbd-plugins

config efixo-nbd-plugin-usharectl
	bool "usharectl plugin" if efixo-nbd-plugins

config efixo-nbd-plugin-printer
        bool "printer plugin" if efixo-nbd-plugins
```

## openwrt/target/linux/brcm63xx/files/arch/mips/bcm63xx/Kconfig
```kconfig
menu "CPU support"
	depends on BCM63XX

config BCM63XX_CPU_6338
	bool "support 6338 CPU"
	select HW_HAS_PCI
	select USB_ARCH_HAS_OHCI
	select USB_OHCI_BIG_ENDIAN_DESC
	select USB_OHCI_BIG_ENDIAN_MMIO
	select USB_ARCH_HAS_UDC

config BCM63XX_CPU_6345
	bool "support 6345 CPU"
	select USB_OHCI_BIG_ENDIAN_DESC
	select USB_OHCI_BIG_ENDIAN_MMIO

config BCM63XX_CPU_6348
	bool "support 6348 CPU"
	select HW_HAS_PCI
	select USB_ARCH_HAS_OHCI
	select USB_OHCI_BIG_ENDIAN_DESC
	select USB_OHCI_BIG_ENDIAN_MMIO
	select USB_ARCH_HAS_UDC

config BCM63XX_CPU_6358
	bool "support 6358 CPU"
	select HW_HAS_PCI
	select USB_ARCH_HAS_OHCI
	select USB_OHCI_BIG_ENDIAN_MMIO
	select USB_ARCH_HAS_EHCI
	select USB_EHCI_BIG_ENDIAN_MMIO
	select BCM63XX_DSP

config BCM63XX_CPU_6362
	bool "support 6362 CPU"
	select HW_HAS_PCI
	select USB_ARCH_HAS_OHCI
	select USB_OHCI_BIG_ENDIAN_MMIO
	select USB_ARCH_HAS_EHCI
	select USB_EHCI_BIG_ENDIAN_MMIO
	select BCM63XX_PCIE
	select BCM63XX_WLAN
	select BCM63XX_DSP
	select BCM63XX_FAP
endmenu

source "arch/mips/bcm63xx/boards/Kconfig"

config BCM63XX_PCIE
	bool

config BCM63XX_WLAN
	bool

config BCM63XX_DSP
	bool

config BCM63XX_FAP
	bool
```

## openwrt/target/linux/brcm63xx/files/arch/mips/bcm63xx/boards/Kconfig
```kconfig
choice
	prompt "Board support"
	depends on BCM63XX
	default BOARD_BCM963XX

config BOARD_BCM963XX
       bool "Generic Broadcom 963xx boards"
	select SSB
       help

config BOARD_LIVEBOX
	bool "Inventel Livebox(es) boards"
	select SSB
	help
	 Inventel Livebox boards using the RedBoot bootloader.

config BOARD_NEUFBOX4
	bool "SFR neufbox4 boards"
	select BCM96358
	select MIPS_BRCM
	help

config BOARD_NEUFBOX6
	bool "SFR neufbox6 boards"
	select BCM96362
	select MIPS_BRCM
	select HAVE_PWM
	help

endchoice

config MIPS_BRCM
	bool

config BCM96358
	bool

config BCM96362
	bool

config HAVE_PWM
	bool

config BCM_FAP
	bool "Bcm FAP"
	help
```

## openwrt/target/linux/brcm63xx/files/drivers/tdm/Kconfig
```kconfig
#
# TDM bus configuration
#
menuconfig TDM
	   bool "TDM support"
	   help
             A TDM bus is one application of the principle of time-division
	     multiplexing.

	     In a TDM Bus, data or information arriving from an input line is
	     put onto specific timeslots on a high-speed bus, where a recipient
	     would listen to the bus and pick out only the signals for
	     a certain timeslot.

	     It resembles the TDM carried out in synchronous optical
	     networking, but the "TDM Bus" term is more commonly used when the
	     bus is inside a single unit like a telecommunications switch or a
	     PC.

if TDM

config TDM_BCM63XX
       tristate "Broadcom BCM63xx TDM controller"
       depends on BCM63XX
       help
         TDM driver for the Broadcom BCM63xx TDM controller.

endif # TDM
```

## openwrt/target/linux/brcm63xx/image/Config.in
```kconfig
choice
	prompt "Broadcom SoC"
	depends on TARGET_brcm63xx

config neufbox_soc_6358
	bool "6358"

config neufbox_soc_6362
	bool "6362"

endchoice

config NEUFBOX_SOC_TYPE
	string
	default "6358" if neufbox_soc_6358
	default "6362" if neufbox_soc_6362
```

## openwrt/target/linux/generic-2.6/image/Config.in
```kconfig
config FIRMWARE_RELEASE
	string "Firmware Release"

config OPERATOR_DOMAIN
	string "Operator domain"
	default "neufbox.neuf.fr"

menuconfig neufbox_net_infra
	bool "neufbox"

config neufbox_net_infra_adsl
	bool "net infra ADSL" if neufbox_net_infra

config neufbox_net_infra_ftth
	bool "net infra FTTH" if neufbox_net_infra

config neufbox_net_infra_gprs
	bool "net infra GPRS" if neufbox_net_infra

config neufbox_net_infra_bridge
	bool "net infra Bridge" if neufbox_net_infra
```
